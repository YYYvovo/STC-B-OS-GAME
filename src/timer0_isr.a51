#include "stc15fxxxx.inc"
#include "xstack.inc"
#include "stack.inc"

EXTERN DATA (INTERRUPT_COUNTER, FLAG_NOSCHED, INTERRUPT_CONTEXT)

SEG_TIMER0_ISR_ENTRY SEGMENT CODE AT 000Bh
RSEG SEG_TIMER0_ISR_ENTRY
	LJMP TIMER0_ISR
	
SEG_TIMER0_ISR SEGMENT CODE
RSEG SEG_TIMER0_ISR
	TIMER0_ISR:
		INC INTERRUPT_COUNTER
		XCH A, FLAG_NOSCHED
		JNZ T0ISR_SKIP
			XCH A, FLAG_NOSCHED
			;SAVE CURRENT STATE
			MOV INTERRUPT_CONTEXT, DPH
			MOV INTERRUPT_CONTEXT+1, DPL
			MOV INTERRUPT_CONTEXT+2, A
			MOV INTERRUPT_CONTEXT+3, B
			MOV INTERRUPT_CONTEXT+4, PSW
			MOV INTERRUPT_CONTEXT+5, R0
			MOV INTERRUPT_CONTEXT+6, R1
			MOV INTERRUPT_CONTEXT+7, R2
			MOV INTERRUPT_CONTEXT+8, R3
			MOV INTERRUPT_CONTEXT+9, R4
			MOV INTERRUPT_CONTEXT+10, R5
			MOV INTERRUPT_CONTEXT+11, R6
			MOV INTERRUPT_CONTEXT+12, R7
			MOV INTERRUPT_CONTEXT+13, ?C_XBP 
			MOV INTERRUPT_CONTEXT+14, ?C_XBP + 1
	
			POP	INTERRUPT_CONTEXT+15
			POP INTERRUPT_CONTEXT+16
			MOV INTERRUPT_CONTEXT+17, SP
			;STATE SAVED
			
			;START TO MOVE TO KERNEL CONTEXT
			;Kernel uses it's own stack and xstack
			MOV SP, #KERNEL_STACK
			MOV ?C_XBP 		, #HIGH (KERNEL_STACK + KERNEL_XSTACKSIZE)
			MOV ?C_XBP + 1  , #LOW 	(KERNEL_STACK + KERNEL_XSTACKSIZE)
			
			EXTERN CODE (TIMER0_ISR_C)
			CALL TIMER0_ISR_C
			;Kernel processing end.
			
			;Load process state.
			MOV SP, INTERRUPT_CONTEXT+17
			PUSH INTERRUPT_CONTEXT+16
			PUSH INTERRUPT_CONTEXT+15
	
			MOV DPH, INTERRUPT_CONTEXT
			MOV DPL, INTERRUPT_CONTEXT+1
			MOV A, INTERRUPT_CONTEXT+2
			MOV B, INTERRUPT_CONTEXT+3
			MOV PSW, INTERRUPT_CONTEXT+4
			MOV R0, INTERRUPT_CONTEXT+5
			MOV R1, INTERRUPT_CONTEXT+6
			MOV R2, INTERRUPT_CONTEXT+7
			MOV R3, INTERRUPT_CONTEXT+8
			MOV R4, INTERRUPT_CONTEXT+9
			MOV R5, INTERRUPT_CONTEXT+10
			MOV R6, INTERRUPT_CONTEXT+11
			MOV R7, INTERRUPT_CONTEXT+12
			MOV ?C_XBP, INTERRUPT_CONTEXT+13
			MOV ?C_XBP + 1, INTERRUPT_CONTEXT+14
			RETI
		 
		T0ISR_SKIP:
		XCH A, FLAG_NOSCHED
		RETI

END
	
	