#include "STC15FXXXX.inc"
#include "xstack.inc"
#include "stack.inc"

EXTERN DATA (INTERRUPT_CONTEXT)
EXTERN CODE (PCA_ISR_C)

SEG_SYSCALL_ENTRY SEGMENT CODE AT 0x003B
RSEG SEG_SYSCALL_ENTRY
	LJMP SYSCALL_ISR
	
SEG_SYSCALL_ISR SEGMENT CODE
RSEG SEG_SYSCALL_ISR
	SYSCALL_ISR:
		;SAVE CURRENT STATE
		MOV INTERRUPT_CONTEXT, DPH
		MOV INTERRUPT_CONTEXT+1, DPL
		MOV INTERRUPT_CONTEXT+2, A
		MOV INTERRUPT_CONTEXT+3, B
		MOV INTERRUPT_CONTEXT+4, PSW
		MOV INTERRUPT_CONTEXT+5, R0
		MOV INTERRUPT_CONTEXT+6, R1
		MOV INTERRUPT_CONTEXT+7, R2
		MOV INTERRUPT_CONTEXT+8, R3
		MOV INTERRUPT_CONTEXT+9, R4
		MOV INTERRUPT_CONTEXT+10, R5
		MOV INTERRUPT_CONTEXT+11, R6
		MOV INTERRUPT_CONTEXT+12, R7
		MOV INTERRUPT_CONTEXT+13, ?C_XBP 
		MOV INTERRUPT_CONTEXT+14, ?C_XBP + 1

		POP	INTERRUPT_CONTEXT+15
		POP INTERRUPT_CONTEXT+16
		MOV INTERRUPT_CONTEXT+17, SP
		;STATE SAVED
		
		;START TO MOVE TO KERNEL CONTEXT
		;Kernel uses it's own stack and xstack
		MOV SP, #KERNEL_STACK
		MOV ?C_XBP 		, #HIGH (KERNEL_STACK + KERNEL_XSTACKSIZE)
		MOV ?C_XBP + 1  , #LOW 	(KERNEL_STACK + KERNEL_XSTACKSIZE)
	
		CALL PCA_ISR_C
		
		;Kernel processing end.
		;Load process state.
		MOV SP, INTERRUPT_CONTEXT+17
		PUSH INTERRUPT_CONTEXT+16
		PUSH INTERRUPT_CONTEXT+15

		MOV DPH, INTERRUPT_CONTEXT
		MOV DPL, INTERRUPT_CONTEXT+1
		MOV A, INTERRUPT_CONTEXT+2
		MOV B, INTERRUPT_CONTEXT+3
		MOV PSW, INTERRUPT_CONTEXT+4
		MOV R0, INTERRUPT_CONTEXT+5
		MOV R1, INTERRUPT_CONTEXT+6
		MOV R2, INTERRUPT_CONTEXT+7
		MOV R3, INTERRUPT_CONTEXT+8
		MOV R4, INTERRUPT_CONTEXT+9
		MOV R5, INTERRUPT_CONTEXT+10
		MOV R6, INTERRUPT_CONTEXT+11
		MOV R7, INTERRUPT_CONTEXT+12
		MOV ?C_XBP, INTERRUPT_CONTEXT+13
		MOV ?C_XBP + 1, INTERRUPT_CONTEXT+14
		RETI

SEG_SYSCALL_INVOKE SEGMENT CODE
RSEG SEG_SYSCALL_INVOKE
	PUBLIC SYSCALL, _SYSCALL
	_SYSCALL:
	SYSCALL:
		;syscall id in R7
		;syscall parameter in R4R5, R2R3
		ORL CCON, #4	;CCON^2 = 1, interrupt on next instruction
		RET
		
END